## prj.conf
```kconfig
CONFIG_CONSOLE=y
CONFIG_I2C=y
CONFIG_I2S=y
CONFIG_NEWLIB_LIBC=y
CONFIG_STDOUT_CONSOLE=y
CONFIG_USB_DEVICE_STACK=y
CONFIG_USB_DEVICE_PRODUCT="Zephyr CDC ACM sample"
CONFIG_USB_DEVICE_PID=0x0001
CONFIG_SERIAL=y
CONFIG_UART_INTERRUPT_DRIVEN=y
CONFIG_UART_LINE_CTRL=y
CONFIG_CPP=y
CONFIG_EVENTS=y
CONFIG_CMSIS_DSP=y
CONFIG_FPU=y
CONFIG_CMSIS_DSP_TRANSFORM=y
CONFIG_CMSIS_DSP_FILTERING=y
```

## src/main.cpp
```c
/*
 * Copyright (c) 2016 Intel Corporation
 *
 * SPDX-License-Identifier: Apache-2.0
 */

#include "Switch.hpp"
#include "audio.h"
#include "key.hpp"
#include "leds.h"
#include "peripherals.h"
#include "synth.hpp"
#include "usb.h"
#include <math.h>
#include <zephyr/kernel.h>
#include <zephyr/drivers/gpio.h>
#include <zephyr/logging/log.h>

Synthesizer synth;

int ret = 0;
const struct gpio_dt_spec sw_osc_dn = GPIO_DT_SPEC_GET(DT_ALIAS(switch0), gpios);
const struct gpio_dt_spec sw_osc_up = GPIO_DT_SPEC_GET(DT_ALIAS(switch1), gpios);
const struct gpio_dt_spec sw1_dn = GPIO_DT_SPEC_GET(DT_ALIAS(switch4), gpios);
const struct gpio_dt_spec sw1_up = GPIO_DT_SPEC_GET(DT_ALIAS(switch5), gpios);
const struct gpio_dt_spec sw2_dn = GPIO_DT_SPEC_GET(DT_ALIAS(switch6), gpios);
const struct gpio_dt_spec sw2_up = GPIO_DT_SPEC_GET(DT_ALIAS(switch7), gpios);
const struct gpio_dt_spec sw3_dn = GPIO_DT_SPEC_GET(DT_ALIAS(switch2), gpios);
const struct gpio_dt_spec sw3_up = GPIO_DT_SPEC_GET(DT_ALIAS(switch3), gpios);
static struct gpio_callback switch_data;
k_tid_t task3 = NULL;
/// Function that checks key presses
void check_keyboard() {
  char character;
  while (usbRead(&character, 1)) {
    auto key = Key::char_to_key(character);
    bool key_pressed = false;
    for (int i = 0; i < MAX_KEYS; i++) {
      if (key == keys[i].key && keys[i].state != IDLE) {
        keys[i].state = PRESSED;
        keys[i].hold_time = sys_timepoint_calc(K_MSEC(500));
        keys[i].release_time = sys_timepoint_calc(K_MSEC(500));
        key_pressed = true;
      }
    }
    // The second loop is necessary to avoid selecting an IDLE key when a
    // PRESSED or RELEASED key is located further away on the array
    if (!key_pressed) {
      for (int i = 0; i < MAX_KEYS; i++) {
        if (keys[i].state == IDLE) {
          keys[i].key = key;
          keys[i].state = PRESSED;
          keys[i].hold_time = sys_timepoint_calc(K_MSEC(500));
          keys[i].release_time = sys_timepoint_calc(K_MSEC(500));
          keys[i].phase1 = 0;
          keys[i].phase2 = 0;
          break;
        }
      }
    }
  }
}
// Task 1
void peripheral_update_thread(void *, void *, void *) {
  printuln("peripheral_update_thread");
  while (true) {
    set_led(&debug_led0);
    peripherals_update();
    reset_led(&debug_led0);
    k_msleep(15);
  }
}

// Task 2
void check_keyboard_thread(void *, void *, void *) {
  printuln("check_keyboard_thread");
  while (true) {
    set_led(&debug_led1);
    check_keyboard();
    reset_led(&debug_led1);
    k_msleep(1);
  }

}


K_SEM_DEFINE(make_write_synth, 0, 1);

static void audio_timer_callback(struct k_timer *timer_id)
{
  k_sem_give(&make_write_synth);
}
K_TIMER_DEFINE(audio_timer, audio_timer_callback, NULL);

// Task 3
void synth_timer_callback(struct k_timer * timer);

K_TIMER_DEFINE(make_synth_timer, synth_timer_callback, NULL);

// Ensure buffer/block size and timer period align
// Buffer for writing to audio driver
// void *mem_block = allocBlock();
// K_MEM_SLAB_DEFINE(audio_buffer, 400, 2, 4);
void *mem_block_synth = allocBlock();
void *mem_block_write = allocBlock();
[[noreturn]] void make_write_synth_thread(void *, void *, void *) {
  k_msleep(5);
  reset_led(&status_led4);
  printuln("make_write_synth_thread");
  void *block_ptr_active = mem_block_synth;
  void *block_ptr_inactive = mem_block_write;

  while (true) {
    k_timer_start(&make_synth_timer, K_MSEC(25), K_NO_WAIT);
    k_sem_take(&make_write_synth, K_FOREVER);
    // Make synth sound (Red LED, LD5, Task 3, LogicAnalyzer CH2)
    set_led(&debug_led2);
    // synth.makesynth((uint8_t *)mem_block);
    synth.makesynth((uint8_t *)block_ptr_active);
    reset_led(&debug_led2);

    void *temp = block_ptr_active;
    block_ptr_active = block_ptr_inactive;
    block_ptr_inactive = temp;

    k_msleep(7);
    k_timer_stop(&make_synth_timer);
  }
}


#define GENERAL_STACK_SIZE 20000
#define T1_PRIORITY (1)
#define T2_PRIORITY (2)
#define T3_PRIORITY (3)
#define T4_PRIORITY (-1)
// TODO: We changed the t4 priority to -1 because we never want write audio to be interrupted,
// write in report



K_THREAD_STACK_DEFINE(task_1_stack_area, GENERAL_STACK_SIZE);
struct k_thread task_1_data;
K_THREAD_STACK_DEFINE(task_2_stack_area, GENERAL_STACK_SIZE);
struct k_thread task_2_data;
K_THREAD_STACK_DEFINE(task_3_stack_area, GENERAL_STACK_SIZE);
struct k_thread task_3_data;
K_THREAD_STACK_DEFINE(task_4_stack_area, GENERAL_STACK_SIZE);
struct k_thread task_4_data;



void synth_timer_callback(struct k_timer * timer) {
  printuln("OVERLOAD. Abort.");
  k_thread_abort(task3);
  memset(mem_block_synth, 0, 4410); // set all to 0
  memset(mem_block_write, 0, 4410);

  set_led(&status_led4);


  printuln("Resuming synth");
  task3 = k_thread_create(&task_3_data, task_3_stack_area,
                                 K_THREAD_STACK_SIZEOF(task_3_stack_area),
                                 make_write_synth_thread,
                                 NULL, NULL, NULL,
                                 T3_PRIORITY, 0, K_NO_WAIT);

}

// Task 4
void write_audio_thread(void * p1, void * p2, void * p3) {
  printuln("write_audio_thread");
  void *block_ptr_active = mem_block_synth;
  void *block_ptr_inactive = mem_block_write;

  while (true) {
    // Write audio block (Blue LED, LD6, Task 4, LogicAnalyzer CH3)
    set_led(&debug_led3);
    // writeBlock(mem_block);
    writeBlock(block_ptr_active);
    reset_led(&debug_led3);

    void *temp = block_ptr_active;
    block_ptr_active = block_ptr_inactive;
    block_ptr_inactive = temp;
    k_msleep(50);
  }
}
static void debounce_thread(struct k_work *work) {
  printuln("debounce_thread");
  for (int i = 0; i < N_SWITCHES; i++) {
    switches[i].update();
  }
}
static K_WORK_DELAYABLE_DEFINE(debounce_work, debounce_thread);

// ISR
void switch_switched(const struct device *dev, struct gpio_callback *cb, gpio_port_pins_t pins) {
  set_led(&status_led4);
  k_work_reschedule(&debounce_work, K_MSEC(15));
  reset_led(&status_led4);
}

int main(void) {

  initUsb();
  waitForUsb();

  printuln("== Initializing... ==");

  init_leds();
  initAudio();
  init_peripherals();

  synth.initialize();
  printuln("Initializing interrupts");
  // gpio_pin_configure_dt(&sw_osc_dn, GPIO_INPUT);
  // gpio_pin_configure_dt(&sw_osc_up, GPIO_INPUT);



  gpio_pin_interrupt_configure_dt(&sw_osc_dn, GPIO_INT_TRIG_LOW);
  gpio_pin_interrupt_configure_dt(&sw_osc_up, GPIO_INT_TRIG_LOW);

  gpio_pin_interrupt_configure_dt(&sw1_dn, GPIO_INT_TRIG_LOW);
  gpio_pin_interrupt_configure_dt(&sw1_up, GPIO_INT_TRIG_LOW);
  gpio_pin_interrupt_configure_dt(&sw2_dn, GPIO_INT_TRIG_LOW);
  gpio_pin_interrupt_configure_dt(&sw2_up, GPIO_INT_TRIG_LOW);
  gpio_pin_interrupt_configure_dt(&sw3_dn, GPIO_INT_TRIG_LOW);
  gpio_pin_interrupt_configure_dt(&sw3_up, GPIO_INT_TRIG_LOW);
  gpio_init_callback(
      &switch_data,
      switch_switched,
      BIT(sw_osc_dn.pin) |
          BIT(sw_osc_up.pin) |
          BIT(sw1_dn.pin) |
          BIT(sw1_up.pin) |
          BIT(sw2_dn.pin) |
          BIT(sw2_up.pin) |
          BIT(sw3_dn.pin) |
          BIT(sw3_up.pin)
  );
  gpio_add_callback(sw_osc_dn.port, &switch_data);
  gpio_add_callback(sw_osc_up.port, &switch_data);

  gpio_add_callback(sw1_dn.port, &switch_data);
  gpio_add_callback(sw1_up.port, &switch_data);
  gpio_add_callback(sw2_dn.port, &switch_data);
  gpio_add_callback(sw2_up.port, &switch_data);
  gpio_add_callback(sw3_dn.port, &switch_data);
  gpio_add_callback(sw3_up.port, &switch_data);

  printuln("== Finished initialization ==");

  int64_t time = k_uptime_get();
  k_timer_start(&audio_timer, K_MSEC(5), K_MSEC(5));

  // Check the peripherals input (Green LED, LD4, Task 1, LogicAnalyzer CH0)
  k_tid_t task1 = k_thread_create(&task_1_data, task_1_stack_area,
                                   K_THREAD_STACK_SIZEOF(task_1_stack_area),
                                   peripheral_update_thread,
                                   NULL, NULL, NULL,
                                   T1_PRIORITY, 0, K_NO_WAIT);
  // Get user input from the keyboard (Orange LED, LD3, Task 2, LogicAnalyzer CH1)
  k_tid_t task2 = k_thread_create(&task_2_data, task_2_stack_area,
                                   K_THREAD_STACK_SIZEOF(task_2_stack_area),
                                   check_keyboard_thread,
                                   NULL, NULL, NULL,
                                   T2_PRIORITY, 0, K_NO_WAIT);
  // Make synth sound (Red LED, LD5, Task 3, LogicAnalyzer CH2) and write audio block (Blue LED, LD6, Task 4, LogicAnalyzer CH3)
 task3 = k_thread_create(&task_3_data, task_3_stack_area,
                                 K_THREAD_STACK_SIZEOF(task_3_stack_area),
                                 make_write_synth_thread,
                                 NULL, NULL, NULL,
                                 T3_PRIORITY, 0, K_NO_WAIT);

  k_tid_t task4 = k_thread_create(&task_4_data, task_4_stack_area,
                                 K_THREAD_STACK_SIZEOF(task_4_stack_area),
                                 write_audio_thread,
                                 NULL, NULL, NULL,
                                 T4_PRIORITY, 0, K_NO_WAIT);

  int state = 0;
  while (1) {

    // Run the superloop slightly faster than once every 50 ms
    if (k_uptime_get() - time > BLOCK_GEN_PERIOD_MS-1) {
      time = k_uptime_get();
      if (state) {
        set_led(&status_led0);
      } else {
        reset_led(&status_led0);
      }
      state = !state;
    }


    k_msleep(10);
  }
}
```

## src/Switch.cpp
```c
#include "Switch.hpp"
#include "usb.h"

#include <zephyr/drivers/gpio.h>

bool get_button(const struct gpio_dt_spec *button) {
  return gpio_pin_get_dt(button);
}

int ThreePosSwitch::initialize(const struct gpio_dt_spec *up,
                               const struct gpio_dt_spec *down,
                               sw3_callback callback) {
  _callback = callback;
  _up = up;
  _down = down;

  // Configure the first GPIO
  if (!gpio_is_ready_dt(_up)) {
    printuln("GPIO up was not ready.");
    return -1;
  }
  gpio_pin_configure_dt(_up, GPIO_INPUT | GPIO_PULL_UP);

  // Configure the second GPIO
  if (!gpio_is_ready_dt(_down)) {
    printuln("GPIO down was not ready.");
    return -1;
  }
  gpio_pin_configure_dt(_down, GPIO_INPUT | GPIO_PULL_UP);

  return 0;
}

void ThreePosSwitch::update() {
  // Get the new state
  bool up = gpio_pin_get_dt(_up);
  bool dn = gpio_pin_get_dt(_down);
  if (up == dn) {
    _current_state = Neutral;
  } else if (up) {
    _current_state = Up;
  } else {
    _current_state = Down;
  }

  // If the state is different, call the callback
  if (_current_state != _previous && _callback != nullptr) {
    _callback(*this);
  }

  // Update the invariant
  _previous = _current_state;
}
```

## src/audio.cpp
```c
#include "audio.h"
#include "usb.h"
#include <errno.h>
#include <stdint.h>
#include <zephyr/drivers/gpio.h>
#include <zephyr/drivers/i2c.h>
#include <zephyr/drivers/i2s.h>
#include <zephyr/kernel.h>
#include <zephyr/logging/log.h>

#define I2S_TX_NODE DT_NODELABEL(i2s_tx)
K_MEM_SLAB_DEFINE_STATIC(mem_slab, BLOCK_SIZE, BLOCK_COUNT, 4);

/* 1000 msec = 1 sec */
#define SLEEP_TIME_MS 1000

/* The devicetree node identifier for the "led0" alias. */
#define LED0_NODE DT_ALIAS(led0)
#define AUDIO_CS DT_ALIAS(cs0)

static const struct gpio_dt_spec cs = GPIO_DT_SPEC_GET(AUDIO_CS, gpios);
const struct device *const i2s_dev_tx = DEVICE_DT_GET(I2S_TX_NODE);

static int read(uint8_t devaddr, uint8_t regaddr, uint8_t *regval) {
  int ret;

  const struct device *dev = DEVICE_DT_GET(DT_NODELABEL(i2c1));

  if (!device_is_ready(dev)) {
    printuln("Device not ready");
    return -ENODEV;
  }

  ret = i2c_write_read(dev, devaddr, &regaddr, 1, regval, 1);
  if (ret) {
    printuln("Call `i2c_write_read` failed: %d", ret);
    return ret;
  }

  return 0;
}

static int write(uint8_t devaddr, uint8_t regaddr, uint8_t regval) {
  int ret;

  const struct device *dev = DEVICE_DT_GET(DT_NODELABEL(i2c1));

  if (!device_is_ready(dev)) {
    printuln("Device not ready");
    return -ENODEV;
  }

  uint8_t buf[2] = {regaddr, regval};

  ret = i2c_write(dev, buf, 2, devaddr);
  if (ret) {
    printuln("Call `i2c_write` failed: %d", ret);
    return ret;
  }

  return 0;
}

void *allocBlock() {
  void *mem_block;
  int ret = k_mem_slab_alloc(&mem_slab, &mem_block, K_NO_WAIT);
  if (ret < 0) {
    printuln("Failed to allocate TX block: %d\n", ret);
    return nullptr;
  }

  ret = i2s_trigger(i2s_dev_tx, I2S_DIR_TX, I2S_TRIGGER_START);

  return mem_block;
}

int initAudio() {
  int ret;

  // Initialize CS gpio pin
  if (!gpio_is_ready_dt(&cs)) {
    printuln("CS gpio pin was not ready.");
    return ret;
  }
  ret = gpio_pin_configure_dt(&cs, GPIO_OUTPUT_ACTIVE);
  if (ret < 0) {
    printuln("Failed to configure CS gpio pin.");
    return ret;
  }
  ret = gpio_pin_set_dt(&cs, 1);
  if (ret < 0) {
    printuln("Failed to set CS gpio pin to 1.");
    return ret;
  }

  ret = 0;
  ret |= write(0x4A, 0x02, 0x01); // power save registers -> all on
  ret |= write(0x4A, 0x00, 0x99);
  ret |= write(0x4A, 0x47, 0x80);     // inits
  ret |= write(0x4A, 0x0d, 0x03);     // playback ctrl
  ret |= write(0x4A, 0x32, (1 << 7)); // vol
  ret |= write(0x4A, 0x32, (0 << 7)); // vol
  ret |= write(0x4A, 0x00, 0x00);     // inits
  ret |= write(0x4A, 0x04, 0xaf);     // power ctrl
  ret |= write(0x4A, 0x0d, 0x70);
  ret |=
      write(0x4A, 0x05,
            0x81); // clocking: auto speed is determined by the MCLK/LRCK ratio.
  ret |= write(0x4A, 0x06, 0x07); // DAC interface format, I²S 16 bit
  ret |= write(0x4A, 0x0a, 0x00);
  ret |= write(0x4A, 0x27, 0x00);
  ret |= write(0x4A, 0x80, 0x0a); // both channels on
  ret |= write(0x4A, 0x1f, 0x0f);
  ret |= write(0x4A, 0x22, 4 - 80);
  ret |= write(0x4A, 0x23, 4 - 80); // limit headphone volume
  ret |= write(0x4A, 0x02, 0x9e);
  if (ret < 0) {
    printuln("Failed to write config over i2c.");
    return ret;
  }

  ret = setVolume(80);
  if (ret < 0) {
    printuln("Failed to set initial volume");
  }

  struct i2s_config config;

  if (!device_is_ready(i2s_dev_tx)) {
    printuln("%s is not ready\n", i2s_dev_tx->name);
    return -1;
  }

  config.word_size = SAMPLE_BIT_WIDTH;
  config.channels = NUMBER_OF_CHANNELS;
  config.format = I2S_FMT_DATA_FORMAT_I2S;
  config.options = I2S_OPT_BIT_CLK_MASTER | I2S_OPT_FRAME_CLK_MASTER;
  config.frame_clk_freq = SAMPLE_FREQUENCY;
  config.mem_slab = &mem_slab;
  config.block_size = BLOCK_SIZE;
  config.timeout = TIMEOUT;

  ret = i2s_configure(i2s_dev_tx, I2S_DIR_TX, &config);
  if (ret < 0) {
    printuln("Failed to configure TX stream: %d\n", ret);
    return -1;
  }

  printuln("Audio driver initialization finished!");
  return 0;
}

int setVolume(uint8_t volumeValue) {
  int8_t vol;
  if (volumeValue > 100)
    volumeValue = 100;
  // strange mapping, see datasheet
  // vol=25; // -102 dB
  // vol=24  // +12dB

  vol = -90 + (float)80 * volumeValue / 100;

  int ret = 0;
  ret |= write(0x4A, 0x20, vol);
  ret |= write(0x4A, 0x21, vol);
  if (ret < 0) {
    printuln("Failed to set volume.");
    return -1;
  }
  return 0;
}

int writeBlock(void *mem_block) {
  int ret;

  !i2s_trigger(i2s_dev_tx, I2S_DIR_TX, I2S_TRIGGER_START);
  
  ret = i2s_write(i2s_dev_tx, mem_block, BLOCK_SIZE);
  if (ret < 0) {
    printuln("Failed to write block 0: %d", ret);
    if (ret == -5) {
      i2s_trigger(i2s_dev_tx, I2S_DIR_TX, I2S_TRIGGER_PREPARE);
      writeBlock(mem_block);
    }
    return 0;
  }
  return 0;
}
```

## src/audio.h
```c
#ifndef AUDIO_H
#define AUDIO_H

#include <stdint.h>

/**
 * I2S driver configuration constants
*/
#define SAMPLE_FREQUENCY 44100
#define SAMPLE_BIT_WIDTH 16
#define BYTES_PER_SAMPLE sizeof(int16_t)
#define NUMBER_OF_CHANNELS 1
#define TIMEOUT 1000

/**
 * Constants for configuring memory slab used as buffer for I2S driver
*/
// Want to generate a block of audio samples every 50 ms = 0.05 s
#define BLOCK_GEN_PERIOD_S (0.05)
#define BLOCK_GEN_PERIOD_MS (BLOCK_GEN_PERIOD_S * 1000)

// How many samples we can produce within the block generation period given
// the sampling frequency
#define SAMPLES_PER_BLOCK (SAMPLE_FREQUENCY * BLOCK_GEN_PERIOD_S * NUMBER_OF_CHANNELS)

// how large the audio block can be to fill it within the block generation period
#define BLOCK_SIZE (BYTES_PER_SAMPLE * SAMPLES_PER_BLOCK) 

// the number of audio blocks to use
// Changed this to two because we want to implement double buffering
#define BLOCK_COUNT (2)



/// @brief Audio initialization function
/// Call this function before you call any other function from this library
/// @return 0 on success, -ERRNO otherwise
int initAudio();

/// @brief Set the output volume/amplitude of the audio amplifier
/// @param volumeValue volume value, from 0 to 255
/// @return 0 on success, -ERRNO otherwise
int setVolume(uint8_t volumeValue);

/// @brief Initialize the audio buffers
void *allocBlock();

/// @brief Write one of the buffers to the audio amplifier
/// Note: this is accomplished asynchronously through a DMA request
/// @param mem_block the audio buffer
/// @return 0 on success, -ERRNO otherwise
int writeBlock(void *mem_block);

#endif
```

## src/leds.cpp
```c
#include <zephyr/drivers/gpio.h>
#include <zephyr/kernel.h>
#include <zephyr/logging/log.h>
#include "leds.h"
#include "usb.h"

const struct gpio_dt_spec debug_led0 = GPIO_DT_SPEC_GET(DT_ALIAS(debug_led0), gpios);
const struct gpio_dt_spec debug_led1 = GPIO_DT_SPEC_GET(DT_ALIAS(debug_led1), gpios);
const struct gpio_dt_spec debug_led2 = GPIO_DT_SPEC_GET(DT_ALIAS(debug_led2), gpios);
const struct gpio_dt_spec debug_led3 = GPIO_DT_SPEC_GET(DT_ALIAS(debug_led3), gpios);

const struct gpio_dt_spec status_led0 = GPIO_DT_SPEC_GET(DT_ALIAS(status_led0), gpios);
const struct gpio_dt_spec status_led1 = GPIO_DT_SPEC_GET(DT_ALIAS(status_led1), gpios);
const struct gpio_dt_spec status_led2 = GPIO_DT_SPEC_GET(DT_ALIAS(status_led2), gpios);
const struct gpio_dt_spec status_led3 = GPIO_DT_SPEC_GET(DT_ALIAS(status_led3), gpios);
const struct gpio_dt_spec status_led4 = GPIO_DT_SPEC_GET(DT_ALIAS(status_led4), gpios);

static const struct gpio_dt_spec* leds[] = {
    &debug_led0,
    &debug_led1,
    &debug_led2,
    &debug_led3,
    &status_led0,
    &status_led1,
    &status_led2,
    &status_led3,
    &status_led4
};

int init_leds() {
    for(int i = 0; i < N_LEDS; i++) {
        const struct gpio_dt_spec* led = leds[i];
        if (!gpio_is_ready_dt(led)) {
            printk("GPIO led was not ready.");
            return -1;
        }

        gpio_pin_configure_dt(led, GPIO_OUTPUT_ACTIVE);
        gpio_pin_set_dt(led, false);
    }

    for (int i = 0; i < N_LEDS; i++) {
        reset_led(leds[i]);
    }
    printuln("LED initialization finished!");
    return 0;
}


int set_led(const struct gpio_dt_spec* led) {
    gpio_pin_set_dt(led, true);
    return 0;
}

int reset_led(const struct gpio_dt_spec* led) {
    gpio_pin_set_dt(led, false);
    return 0;
}
```

## src/peripherals.cpp
```c
#include "peripherals.h"

#include <zephyr/drivers/gpio.h>
#include <zephyr/drivers/i2c.h>

#include "usb.h"

// Port expanders registers addresses:
static const uint8_t INPUT_PORT_0 = 0x00;
static const uint8_t INPUT_PORT_1 = 0x01;
static const uint8_t OUTPUT_PORT_0 = 0x02;
static const uint8_t OUTPUT_PORT_1 = 0x03;
static const uint8_t POLARITY_INVERSION_PORT_0 = 0x04;
static const uint8_t POLARITY_INVERSION_PORT_1 = 0x05;
static const uint8_t CONFIG_PORT_0 = 0x06;
static const uint8_t CONFIG_PORT_1 = 0x07;

// Usefull port addresses
static const uint8_t INPUT_PORTS_ADDR[] = {INPUT_PORT_0, INPUT_PORT_1};
static const uint8_t CONFIG_PORTS_ADDR[] = {CONFIG_PORT_0, CONFIG_PORT_1};

// I2C address
static const uint8_t PORT_EXPANDER_ADDR0 = 0b0100000;

// Rotary encoders
RotaryEncoder encoders[N_ENCODERS];

// GPIOs
const struct gpio_dt_spec sw_osc_dn = GPIO_DT_SPEC_GET(DT_ALIAS(switch0), gpios);
const struct gpio_dt_spec sw_osc_up = GPIO_DT_SPEC_GET(DT_ALIAS(switch1), gpios);
const struct gpio_dt_spec sw1_dn = GPIO_DT_SPEC_GET(DT_ALIAS(switch4), gpios);
const struct gpio_dt_spec sw1_up = GPIO_DT_SPEC_GET(DT_ALIAS(switch5), gpios);
const struct gpio_dt_spec sw2_dn = GPIO_DT_SPEC_GET(DT_ALIAS(switch6), gpios);
const struct gpio_dt_spec sw2_up = GPIO_DT_SPEC_GET(DT_ALIAS(switch7), gpios);
const struct gpio_dt_spec sw3_dn = GPIO_DT_SPEC_GET(DT_ALIAS(switch2), gpios);
const struct gpio_dt_spec sw3_up = GPIO_DT_SPEC_GET(DT_ALIAS(switch3), gpios);

// Switches
ThreePosSwitch switches[N_SWITCHES];

static const struct device *i2c_dev = DEVICE_DT_GET(DT_NODELABEL(i2c1));
static uint8_t ports[2];

// Hardcoded port and bit assignment function
// There is no other way
int get_port_and_index(unsigned int encoder_id, unsigned int pin,
                       unsigned int &port, unsigned int &index) {
  if (encoder_id >= N_ENCODERS || pin > 1) {
    return -EINVAL;
  }

  switch (encoder_id) {
  case 0:
    port = 0;
    index = 0 + pin;
    break;
  case 1:
    port = 0;
    index = 2 + pin;
    break;
  case 2:
    port = 0;
    index = 4 + pin;
    break;
  case 3:
    port = 0;
    index = 6 + pin;
    break;
  case 4:
    port = 1;
    index = 0 + pin;
    break;
  case 5:
    port = 1;
    index = 2 + pin;
    break;
  default:
    break;
  }
  return 0;
}

int init_peripherals() {
  // Check the I2c port
  if (!device_is_ready(i2c_dev)) {
    printuln("I2C device not ready");
    return 1;
  }

  // Get the initial state of the device
  int ret = 0;
  for (int j = 0; j < 2; j++) {
    ret = i2c_write_read(i2c_dev, PORT_EXPANDER_ADDR0,
                          &INPUT_PORTS_ADDR[j], 1, &ports[j], 1);
    if (ret != 0) {
      printuln("Failed reading port expander.");
      return ret;
    }
  }

  // Instantiate the rotary encoders
  for (int i = 0; i < N_ENCODERS; i++) {
    // Get the encoder's pins
    unsigned int port;
    unsigned int index0;
    unsigned int index1;
    get_port_and_index(i, 0, port, index0);
    get_port_and_index(i, 1, port, index1);
    uint8_t pin0 = (ports[port] >> index0) & 0x01;
    uint8_t pin1 = (ports[port] >> index1) & 0x01;

    // Initialize the encoder
    encoders[i].initialize(i, pin0, pin1);
  }

  // Initialize the switches
  switches[OSC_SEL_SW].initialize(&sw_osc_up, &sw_osc_dn);
  switches[EFFECTS_SEL_SW].initialize(&sw1_up, &sw1_dn);
  switches[EFFECTS_TARGET_SW].initialize(&sw2_up, &sw2_dn);
  switches[EFFECTS_CONF_SW].initialize(&sw3_up, &sw3_dn);

  printuln("Peripherals initialization completed!");

  return 0;
}

int peripherals_update() {
  // Get the new ports states
  int ret = 0;
  for (int j = 0; j < 2; j++) {
    ret = i2c_write_read(i2c_dev, PORT_EXPANDER_ADDR0,
                          &INPUT_PORTS_ADDR[j], 1, &ports[j], 1);
    if (ret != 0) {
      printuln("Failed reading port expander.");
      return ret;
    }
  }

  // Update the switches
  // MOVED THIS TO WORKTHREAD
  // for (int i = 0; i < N_SWITCHES; i++) {
  //   switches[i].update();
  // }

  // Update the rotary encoders
  for (int i = 0; i < N_ENCODERS; i++) {
    // Get the encoder's pins
    unsigned int port;
    unsigned int index0;
    unsigned int index1;
    get_port_and_index(i, 0, port, index0);
    get_port_and_index(i, 1, port, index1);
    uint8_t pin0 = (ports[port] >> index0) & 0x01;
    uint8_t pin1 = (ports[port] >> index1) & 0x01;

    // Initialize the encoder
    encoders[i].update(pin0, pin1);
  }

  return 0;
}
```

## src/peripherals.h
```c
#ifndef __PERIPHERALS_H__
#define __PERIPHERALS_H__

#include "RotaryEncoder.hpp"
#include "Switch.hpp"
#include "stdint.h"

const unsigned int N_ENCODERS = 6;
const unsigned int N_SWITCHES = 4;

/// @brief Peripheral encoders
extern RotaryEncoder encoders[N_ENCODERS];

// Multiplexing encoder for LPF resonance frequency
// and encoder for oscillator frequency
const uint8_t LPF_RES_ENC = 0;
const uint8_t OSC_FREQ_ENC = 0;

// Multiplexing encoder for LPF cutoff frequency
// and encoder for oscillator wave selection
const uint8_t LPF_CUTOFF_ENC = 1;
const uint8_t OSC_WAVE_ENC = 1;

const uint8_t OSC_VOLUME_ENC = 2;

// Multiplexing encoder for LFO frequency and
// encoder for amplitude modulator attack
const uint8_t LFO_FREQ_ENC = 3;
const uint8_t AMP_MOD_ATT_ENC = 3;

// Multiplexing encoder for LFO amplitude and
// encoder for amplitude modulator sustain
const uint8_t LFO_AMP_ENC = 4;
const uint8_t AMP_MOD_SUS_ENC = 4;

// Encoder for configuring amplitude modulator release
const uint8_t AMP_REL_ENC = 5;


/// @brief Peripheral switches
extern ThreePosSwitch switches[N_SWITCHES];

/// @brief Low Pass Filter/Oscillator selection switch
const uint8_t OSC_SEL_SW = 0;
/// @brief Switch that selects between LFOs, amplitude modulation and effects
const uint8_t EFFECTS_SEL_SW = 1;
/// @brief Switch that selects where the effect is applied
const uint8_t EFFECTS_TARGET_SW = 2;
/// @brief Switch that selects internal effects parameters. For instance, for
/// the LFO, the type of oscillator that you want
const uint8_t EFFECTS_CONF_SW = 3;

/// @brief Peripherals initialization function
/// Call this function during initialization before calling the rest of the fuctions
/// @return 0 on success, -ERRNO otherwise
int init_peripherals();

/// @brief Call this function to update the encoders and switches
/// @return 0 on success, -ERRNO otherwise
int peripherals_update();

/// @brief Read the port expander's port 0
/// @return the port expander's port 0
int8_t read_port0();

/// @brief Read the port expander's port 1
/// @return the port expander's port 1
int8_t read_port1();

#endif
```

## src/synth.cpp
```c
#include "synth.hpp"

#include <math.h>
#include <stdint.h>

#include "audio.h"
#include "leds.h"
#include "peripherals.h"
#include "sine.hpp"

void Synthesizer::initialize() {
  // Initial values for oscillator/LPF
  // to avoid setting encoders to uninitialized values
  synth._osc1.wave_enc = 20;
  synth._osc1.volume_enc = 40;
  synth._osc1.freq_shift_enc = 24;

  synth._osc2.wave_enc = 20;
  synth._osc2.volume_enc = 40;
  synth._osc2.freq_shift_enc = 24;

  synth._lpf._cutoff_enc = 0;
  synth._lpf._resonance_enc = 0;
  synth._master_volume_enc = 40;

  // Done here since the OSC sw's "previous" value is Neutral
  encoders[LPF_CUTOFF_ENC].set_state(synth._lpf._cutoff_enc);
  encoders[OSC_VOLUME_ENC].set_state(synth._master_volume_enc);
  encoders[LPF_RES_ENC].set_state(
      synth._lpf._resonance_enc);  // no frequency shift initially

  // Define the encoders callbacks
  encoders[OSC_WAVE_ENC].set_callback(lpf_cutoff_wavetype_encoder_callback);
  encoders[OSC_VOLUME_ENC].set_callback(volume_encoder_callback);
  encoders[OSC_FREQ_ENC].set_callback(lpf_res_osc_freq_encoder_callback);

  encoders[LFO_FREQ_ENC].set_callback(lfo_freq_amp_mod_attack_callback);
  encoders[LFO_AMP_ENC].set_callback(lfo_amp_amp_mod_sustain_callback);
  encoders[AMP_REL_ENC].set_callback(amp_mod_release_callback);

  // Define the switches callbacks and call them once
  switches[OSC_SEL_SW]._callback = oscillator_selection_switch_callback;
  switches[OSC_SEL_SW].update();
  switches[EFFECTS_TARGET_SW]._callback = lfo_target_switch_callback;
  switches[EFFECTS_TARGET_SW].update();
  switches[EFFECTS_CONF_SW]._callback = effects_configuration_switch_callback;
  switches[EFFECTS_CONF_SW].update();
  switches[EFFECTS_SEL_SW]._callback = effects_selection_switch_callback;
  switches[EFFECTS_SEL_SW].update();

  // Set initial values of oscillator encoders in preparation for callback
  switch (switches[OSC_SEL_SW]._previous) {
    case Up:
      encoders[OSC_WAVE_ENC].set_state(synth._osc1.wave_enc);
      encoders[OSC_VOLUME_ENC].set_state(synth._osc1.volume_enc);
      encoders[OSC_FREQ_ENC].set_state(
          synth._osc1.freq_shift_enc);  // no frequency shift initially
      break;
    case Down:
      encoders[OSC_WAVE_ENC].set_state(synth._osc2.wave_enc);
      encoders[OSC_VOLUME_ENC].set_state(synth._osc2.volume_enc);
      encoders[OSC_FREQ_ENC].set_state(
          synth._osc2.freq_shift_enc);  // no frequency shift initially
      break;
    case Neutral:
      encoders[LPF_CUTOFF_ENC].set_state(synth._lpf._cutoff_enc);
      encoders[OSC_VOLUME_ENC].set_state(synth._master_volume_enc);
      encoders[LPF_RES_ENC].set_state(synth._lpf._resonance_enc);
      break;
  }

  oscillator_selection_switch_callback(switches[OSC_SEL_SW]);
  lfo_target_switch_callback(switches[EFFECTS_TARGET_SW]);
  effects_configuration_switch_callback(switches[EFFECTS_CONF_SW]);
  effects_selection_switch_callback(switches[EFFECTS_SEL_SW]);

  printuln("Synthesizer initialization finished!");
}

/**
 * Oscillator and LPF callbacks
 */
void oscillator_selection_switch_callback(ThreePosSwitch &sw) {
  // Save the previous state
  switch (sw._previous) {
    case Neutral:
      synth._master_volume_enc = encoders[OSC_VOLUME_ENC].get_state();
      synth._lpf._cutoff_freq = encoders[LPF_CUTOFF_ENC].get_state();
      synth._lpf._resonance_freq = encoders[LPF_RES_ENC].get_state();
      break;
    case Up:
      synth._osc1.volume_enc = encoders[OSC_VOLUME_ENC].get_state();
      synth._osc1.wave_enc = encoders[OSC_WAVE_ENC].get_state();
      synth._osc1.freq_shift_enc = encoders[OSC_FREQ_ENC].get_state();
      break;
    case Down:
      synth._osc2.volume_enc = encoders[OSC_VOLUME_ENC].get_state();
      synth._osc2.wave_enc = encoders[OSC_WAVE_ENC].get_state();
      synth._osc2.freq_shift_enc = encoders[OSC_FREQ_ENC].get_state();
      break;
  }

  // Load the new state
  switch (sw._current_state) {
    case Neutral:
      encoders[OSC_VOLUME_ENC].set_state(synth._master_volume_enc);
      encoders[LPF_CUTOFF_ENC].set_state(synth._lpf._cutoff_freq);
      encoders[LPF_RES_ENC].set_state(synth._lpf._resonance_freq);
      break;
    case Up:
      printuln("SW UP!");
      synth._osc1.enabled = true;
      encoders[OSC_VOLUME_ENC].set_state(synth._osc1.volume_enc);
      encoders[OSC_WAVE_ENC].set_state(synth._osc1.wave_enc);
      encoders[OSC_FREQ_ENC].set_state(synth._osc1.freq_shift_enc);
      break;
    case Down:
      printuln("SW DOWN!");
      synth._osc2.enabled = true;
      encoders[OSC_VOLUME_ENC].set_state(synth._osc2.volume_enc);
      encoders[OSC_WAVE_ENC].set_state(synth._osc2.wave_enc);
      encoders[OSC_FREQ_ENC].set_state(synth._osc2.freq_shift_enc);
      break;
  }

  // May need to also update the LFO target based on new value of this switch
  ThreeWaySwitchState lfo_target_sw = switches[EFFECTS_TARGET_SW]._current_state;
  ThreeWaySwitchState lfo_amp_mod_sel_sw =
      switches[EFFECTS_SEL_SW]._current_state;

  // Determine old and new values for the LFO target
  lfo_target_t prev_lfo_target = synth._lfo_target;
  lfo_target_t new_lfo_target = get_lfo_target(sw._current_state, lfo_target_sw);

  // If there was a change in target, something either needs to be saved,
  // loaded, or both
  if (new_lfo_target != prev_lfo_target) {
    // In any case, point to the new LFO target
    synth._lfo_target = new_lfo_target;
    printuln("[OSC Select Switch] LFO Target Changed - Old: %d, New: %d",
             prev_lfo_target, new_lfo_target);

    // There was a previously valid LFO target, so save the state
    if (prev_lfo_target != NONE) {
      // Save off previous encoder values
      synth._lfos[prev_lfo_target]._frequency_enc =
          encoders[LFO_FREQ_ENC].get_state();
      synth._lfos[prev_lfo_target]._amplitude_enc =
          encoders[LFO_AMP_ENC].get_state();
    }

    // There is a new valid LFO target, so load the state
    if (new_lfo_target != NONE) {
      // Load new encoder values
      encoders[LFO_FREQ_ENC].set_state(
          synth._lfos[new_lfo_target]._frequency_enc);
      encoders[LFO_AMP_ENC].set_state(
          synth._lfos[new_lfo_target]._amplitude_enc);

      // Call the LFO encoders' callbacks
      encoders[LFO_FREQ_ENC]._callback(encoders[LFO_FREQ_ENC]);
      encoders[LFO_AMP_ENC]._callback(encoders[LFO_AMP_ENC]);
    }
  }

  // Call the encoder's callbacks
  encoders[OSC_VOLUME_ENC]._callback(encoders[OSC_VOLUME_ENC]);
  encoders[OSC_WAVE_ENC]._callback(encoders[OSC_WAVE_ENC]);
  encoders[OSC_FREQ_ENC]._callback(encoders[OSC_FREQ_ENC]);
}

void lpf_res_osc_freq_encoder_callback(RotaryEncoder &encoder) {
  int state = encoder.get_state();

  switch (switches[0]._current_state) {
    case Up:  // configure OSC 1 frequency
      // Clamp encoder value
      encoder.set_state_clamped(state, 0, 47);
      state = encoder.get_state();

      synth._osc1.freq_shift = SHIFT_FREQUENCIES[state];
      printuln("[Frequency Shifter] OSC1: %f Hz", SHIFT_FREQUENCIES[state]);
      break;
    case Down:  // configure OSC 2 frequency
      // Clamp encoder value
      encoder.set_state_clamped(state, 0, 47);
      state = encoder.get_state();

      synth._osc2.freq_shift = SHIFT_FREQUENCIES[state];
      printuln("[Frequency Shifter] OSC2: %f Hz", SHIFT_FREQUENCIES[state]);
      break;
    case Neutral:  // configure LPF resonance frequency
      printuln("[LPF Resonance Frequency] callback not implemented");
      synth._lpf.set_resonance_freq(state);
      break;
  }
}

void lpf_cutoff_wavetype_encoder_callback(RotaryEncoder &encoder) {
  int state = encoder.get_state();
  switch (switches[0]._current_state) {
    case Up:
      synth._osc1.wave = static_cast<wavetype_t>((state >> 3) & 0x03);
      printuln("[Waveform Select] OSC1: %d", synth._osc1.wave);
      break;
    case Down:
      synth._osc2.wave = static_cast<wavetype_t>((state >> 3) & 0x03);
      printuln("[Waveform Select] OSC2: %d", synth._osc2.wave);
      break;
    case Neutral:
      // encoder.set_state_clamped(state, 0, 96);
      // state = encoder.get_state();

      // synth._lpf.set_cutoff_freq(CUTOFF_FREQUENCIES_96[state]);
      printuln("[LPF Cutoff Frequency] callback not implemented");

      break;
  }
}

void volume_encoder_callback(RotaryEncoder &encoder) {
  int state = encoder.get_state();

  encoder.set_state_clamped(state, 0, 50);

  state = encoder.get_state();
  uint16_t volume = state * state * 16;
  uint8_t master_volume = 27 + state * 2;

  // Update the volume
  switch (switches[0]._current_state) {
    case Up:
      synth._osc1.volume = volume;
      if (volume == 0) synth._osc1.enabled = false;
      else synth._osc1.enabled = true;
      printuln("[Volume Encoder]: OSC1: %d", volume);
      break;
    case Down:
      synth._osc2.volume = volume;
      if (volume == 0) synth._osc2.enabled = false;
      else synth._osc2.enabled = true;
      printuln("[Volume Encoder]: OSC2: %d", volume);
      break;
    case Neutral:
      setVolume(master_volume);
      printuln("[Volume Encoder]: MASTER: %d", master_volume);
      break;
    default:
      break;
  }
}

lfo_target_t get_lfo_target(ThreeWaySwitchState osc_sw,
                            ThreeWaySwitchState lfo_target_sw) {

  switch (osc_sw) {
    case Up:
      if (lfo_target_sw == Up) {
        return OSC1_FREQ;
      }
      else if (lfo_target_sw == Down) {
        return OSC1_AMP;
      }
      else return NONE;
    case Down:
      if (lfo_target_sw == Up) {
        return OSC2_FREQ;
      }
      else if (lfo_target_sw == Down) {
        return OSC2_AMP;
      }
      else return NONE;
    case Neutral:
      if (lfo_target_sw == Neutral) {
        return LPF_CUTOFF;
      }
  }
  return NONE;
}

/**
 * LFO and Amplitude Modulator target configuration callbacks
 */
void lfo_target_switch_callback(ThreePosSwitch &sw) {
  // Obtain previous and new LFO targets
  lfo_target_t prev_lfo_target = synth._lfo_target;
  lfo_target_t new_lfo_target =
      get_lfo_target(switches[OSC_SEL_SW]._current_state, sw._current_state);

  // Save encoders values if they were linked to LFO
  if (prev_lfo_target != NONE) {
    synth._lfos[prev_lfo_target]._frequency_enc =
        encoders[LFO_FREQ_ENC].get_state();
    synth._lfos[prev_lfo_target]._amplitude_enc =
        encoders[LFO_AMP_ENC].get_state();
  }

  // Load new encoder values if a valid LFO target has been selected by switches
  if (new_lfo_target != NONE) {
    encoders[LFO_FREQ_ENC].set_state(
        synth._lfos[new_lfo_target]._frequency_enc);
    encoders[LFO_AMP_ENC].set_state(synth._lfos[new_lfo_target]._amplitude_enc);
  }

  // Unconditionally update LFO target to ensure setting to NONE
  synth._lfo_target = new_lfo_target;
  printuln("[LFO Target Switch] LFO Target Changed - Old: %d, New: %d",
           prev_lfo_target, new_lfo_target);
}

void effects_configuration_switch_callback(ThreePosSwitch &sw) {
  printuln("Effects configuration switch not implemented yet.");
}

void effects_selection_switch_callback(ThreePosSwitch &sw) {
  // Load the new state
  switch (sw._current_state) {
    case Up:
      printuln("[SW3] Configuring LFO");
      break;
    case Down:
      printuln("[SW3] Configuring amplitude modulator (not implemented)");
      break;
    case Neutral:
      printuln("[SW3] Configuring special effects (not implemented)");
      break;
  }

  // May need to also update the LFO target based on new value of this switch
  ThreeWaySwitchState lfo_target_sw = switches[EFFECTS_TARGET_SW]._current_state;
  ThreeWaySwitchState osc_sel_sw = switches[OSC_SEL_SW]._current_state;

  // Determine old and new values for the LFO target
  lfo_target_t prev_lfo_target = synth._lfo_target;
  lfo_target_t new_lfo_target =
      get_lfo_target(osc_sel_sw, lfo_target_sw);

  // If there was a change in target, something either needs to be saved,
  // loaded, or both
  if (new_lfo_target != prev_lfo_target) {
    // In any case, point to the new LFO target
    synth._lfo_target = new_lfo_target;
    printuln("[SW3] LFO Target Changed - Old: %d, New: %d", prev_lfo_target,
             new_lfo_target);
    // There was a previously valid LFO target, so save the state
    if (prev_lfo_target != NONE) {
      // Save off previous encoder values
      synth._lfos[prev_lfo_target]._frequency_enc =
          encoders[LFO_FREQ_ENC].get_state();
      synth._lfos[prev_lfo_target]._amplitude_enc =
          encoders[LFO_FREQ_ENC].get_state();
    }

    // There is a new valid LFO target, so load the state
    if (new_lfo_target != NONE) {
      // Load new encoder values
      encoders[LFO_FREQ_ENC].set_state(
          synth._lfos[new_lfo_target]._frequency_enc);
      encoders[LFO_AMP_ENC].set_state(
          synth._lfos[new_lfo_target]._amplitude_enc);

      // Call the LFO encoders' callbacks
      encoders[LFO_FREQ_ENC]._callback(encoders[LFO_FREQ_ENC]);
      encoders[LFO_AMP_ENC]._callback(encoders[LFO_AMP_ENC]);
    }
  }
}

/**
 * LFO and Amplitude Modulator parameter callbacks
 */
void lfo_freq_amp_mod_attack_callback(RotaryEncoder &encoder) {
  int state = encoder.get_state();

  // Determine whether LFO frequency or amplitude modulator attack
  // needs to be modified
  switch (switches[EFFECTS_SEL_SW]._current_state) {
    case Up:  // LFO FREQUENCY
      encoder.set_state_clamped(state, 0, 47);

      // // Determine which LFO frequency to modify
      synth._lfos[synth._lfo_target].set_frequency(
          LFO_FREQUENCIES[encoder.get_state()]);
      printuln("[LFO Frequency] LFO #%d: %f", synth._lfo_target,
               synth._lfos[synth._lfo_target]._frequency);
      break;
    case Down:  // AMPLITUDE MODULATOR ATTACK
      printuln("[AM Attack] callback not implemented");
      break;
    case Neutral:  // SPECIAL EFFECT 0
      printuln("[Special Effect] callback not implemented");
      break;
  }
}

void lfo_amp_amp_mod_sustain_callback(RotaryEncoder &encoder) {
  int state = encoder.get_state();

  switch (switches[EFFECTS_SEL_SW]._current_state) {
    case Up: {  // LFO AMPLITUDE

      encoder.set_state_clamped(state, 0, 95);

      float amplitude = LFO_AMPLITUDES[encoder.get_state()];

      // Determine which LFO amplitude to modify
      synth._lfos[synth._lfo_target].set_amplitude(amplitude);
      printuln("[LFO Amplitude] LFO #%d: %f", synth._lfo_target,
               synth._lfos[synth._lfo_target]._amplitude);
      break;
    }
    case Down: {  // AMPLITUDE MODULATOR SUSTAIN
      printuln("[AM Sustain] callback not implemented");
      break;
    }
    case Neutral: {  // SPECIAL EFFECT 1
      printuln("[Special Effect] callback not implemented");
      break;
    }
  }
}

void amp_mod_release_callback(RotaryEncoder &encoder) {
  printuln("[AM Release] callback not implemented");
}

int Synthesizer::get_osc_sample(osc_t osc, uint16_t phase) {
  int sample = 0;

  switch (osc.wave) {
    case sine:
      sample = ((int)SINE_LUT[phase >> 6]) - 0x8000;
      break;
    case square:
      sample = phase <= 0x8000 ? -0x8000 : 0x8000;
      break;
    case triangle:
      sample = phase <= 0x8000
                   ? 2 * (phase - 0x4000)    // rising edge of triangle
                   : -2 * (phase - 0xC000);  // falling edge of triangle
      break;
    case sawtooth:
      sample = phase - 0x8000;
      break;
  }

  return sample;
}

float Synthesizer::get_sound_sample(Key &key) {
  // Oscillator 1
    int sample1 = 0;

  if (synth._osc1.enabled) {
    // Obtain sound frequency (including any modulation)
    float freq = key.get_freq() * synth._osc1.freq_shift;
    if (synth._lfo_target == OSC1_FREQ) {
      freq += synth._lfos[OSC1_FREQ].get_sample();
    }

    // Calculate current key phase to select correct oscillator sample value
    key.phase1 += freq * 0x10000 / SAMPLE_FREQUENCY;
    sample1 = get_osc_sample(_osc1, key.phase1);

    // Apply desired volume (including any modulation)
    float vol1 = (float)_osc1.volume / 40000.0;
    if (synth._lfo_target == OSC1_AMP) {
      vol1 += synth._lfos[OSC1_AMP].get_sample();
    }
    sample1 *= vol1;
  }

  // Oscillator 2
  int sample2 = 0;

  if (synth._osc2.enabled) {
    // Obtain sound frequency (including any modulation)
    float freq = key.get_freq() * synth._osc2.freq_shift;
    if (synth._lfo_target == OSC2_FREQ) {
      freq += synth._lfos[OSC2_FREQ].get_sample();
    }

    // Calculate current key phase to select correct oscillator sample value
    key.phase2 += freq * 0x10000 / SAMPLE_FREQUENCY;
    sample2 = get_osc_sample(_osc2, key.phase2);

    // Apply desired volume (including any modulation)
    float vol2 = (float)_osc2.volume / 40000.0;
    if (synth._lfo_target == OSC2_AMP) {
      vol2 += synth._lfos[OSC2_AMP].get_sample();
    }
    sample2 *= vol2;
  }

  return (float)(sample1 + sample2);
}

void Synthesizer::makesynth(uint8_t *block) {
  for (int i = 0; i < BLOCK_SIZE; i += 2) {
    float sample = 0;
    // get the synthesized sound for every pressed key
    for (int j = 0; j < MAX_KEYS; j++) {
      if (keys[j].state == PRESSED &&
          !sys_timepoint_expired(keys[j].hold_time)) {
        sample += get_sound_sample(keys[j]);
      } else if (keys[j].state == PRESSED &&
                 sys_timepoint_expired(keys[j].hold_time)) {
        keys[j].state = IDLE;
      }
    }

    // Apply LPF
    if (synth._lpf._cutoff_freq > 0.) {
      sample = synth._lpf.filter(sample);
    }

    // clamp the value
    if (sample > 0x7fff)
      sample = 0x7fff;
    else if (sample < -0x7fff)
      sample = -0x7fff;

    block[i] = (int16_t)sample & 0xFF;
    block[i + 1] = (int16_t)sample >> 8;
  }
}
```

## src/synth.hpp
```c
#ifndef __SYNTH_H__
#define __SYNTH_H__

#include "Switch.hpp"
#include "key.hpp"
#include "peripherals.h"
#include "filter.hpp"
#include "lfo.hpp"
#include "sine.hpp"
#include <stdint.h>
#include "audio.h"

const float SHIFT_FREQUENCIES[] = { 0.250, 0.265, 0.281, 0.297, 0.315, 
                                    0.334, 0.354, 0.375, 0.397, 0.420, 
                                    0.445, 0.472, 0.500, 0.530, 0.561, 
                                    0.595, 0.630, 0.667, 0.707, 0.749, 
                                    0.794, 0.841, 0.891, 0.944, 1.000, 
                                    1.059, 1.122, 1.189, 1.260, 1.335, 
                                    1.414, 1.498, 1.587, 1.682, 1.782, 
                                    1.888, 2.000, 2.119, 2.245, 2.378, 
                                    2.520, 2.670, 2.828, 2.997, 3.175, 
                                    3.364, 3.564, 3.775, 4.000 };

const uint16_t DEFAULT_MASTER_VALUE = 25600;

/// @brief Basic oscillator waves
typedef enum wavetype {
  sine = 0,
  triangle = 1,
  square = 2,
  sawtooth = 3
} wavetype_t;

/// @brief Oscillator data structure
typedef struct osc {
  uint16_t volume;
  int volume_enc;
  wavetype_t wave;
  int wave_enc;
  float freq_shift;
  int freq_shift_enc;
  bool enabled;
} osc_t;


/// @brief Oscillators switch callback
void oscillator_selection_switch_callback(ThreePosSwitch &sw);
/// @brief Encoder 0 callback
void lpf_res_osc_freq_encoder_callback(RotaryEncoder &encoder);
/// @brief Encoder 1 callback
void lpf_cutoff_wavetype_encoder_callback(RotaryEncoder &encoder);
/// @brief Encoder 2 callback
void volume_encoder_callback(RotaryEncoder &encoder);

/// @brief LFO target selector switch callback
void lfo_target_switch_callback(ThreePosSwitch &sw);
void effects_configuration_switch_callback(ThreePosSwitch &sw);
void effects_selection_switch_callback(ThreePosSwitch &sw);

/// @brief Encoder 3 callback
void lfo_freq_amp_mod_attack_callback(RotaryEncoder &encoder);
/// @brief Encoder 4 callback
void lfo_amp_amp_mod_sustain_callback(RotaryEncoder &encoder);
/// @brief Encoder 5 callback
void amp_mod_release_callback(RotaryEncoder &encoder);

/// @brief LUT that outputs the LFO's target based on switch positions
/// @param osc_sw switch 0 state
/// @param lfo_target_sw switch 1 state
/// @param lfo_amp_mod_sel_sw switch 2 state
/// @return the LFO target
lfo_target_t get_lfo_target(ThreeWaySwitchState osc_sw, ThreeWaySwitchState lfo_target_sw);
                            
class Synthesizer {
public:

  int _master_volume_enc;
  osc_t _osc1;
  osc_t _osc2;
  Filter _lpf;
  LFO _lfos[5];
  lfo_target_t _lfo_target;

  /// @brief Synthesizer default constructor
  Synthesizer()
      : _master_volume_enc{DEFAULT_MASTER_VALUE},
        _osc1{DEFAULT_MASTER_VALUE, 0, square, 0, 1., 0, false},
        _osc2{DEFAULT_MASTER_VALUE, 0, square, 0, 1., 0, false},
        _lpf{SAMPLE_FREQUENCY, 0.}
        {
          // Initialize all LFOs
          for (int i = 0; i < 5; i++) {
            _lfos[i] = LFO(0., SAMPLE_FREQUENCY, 0., 0);
          }
          _lfo_target = NONE;
        }
  
  /// @brief Synthesizer initialization function
  /// Call this function during initialization before calling the rest of the fuctions
  void initialize();

  /// @brief Compute the next oscillator output sample
  /// @param osc the oscillator you want to generate sample for
  /// @param phase the current phase to generate sample with
  /// @return the next oscillator sample
  int get_osc_sample(osc_t osc, uint16_t phase);

  /// @brief Compute next sound value for a specific key
  /// @param key the key you want to generate sound with
  /// @return the next sound value
  float get_sound_sample(Key &key);

  /// @brief Populate the audio buffer with sound
  /// @param block the audio buffer
  void makesynth(uint8_t *block);
};

extern Synthesizer synth;

#endif // __SYNTH_H__
```

## src/usb.h
```c
#include <stdint.h>

extern "C" {

/// @brief USB initialization function.
/// Call this function before printing to the serial port
/// @return 0 on success, -ERRNO otherwise
int initUsb();

/// @brief Spinlock that will wait until the port is open on the PC side
/// Use it to guarantee that print functions are not called before the port is open
void waitForUsb();

/// @brief Returns receiver buffer length
/// @return receiver buffer length
int usbRxBufferLen();

/// @brief Read data from the USB port
/// @param data data pointer
/// @param size size of the data pointer
/// @return number of bytes read
int usbRead(char *data, uint32_t size);

/// @brief Returns transmitter buffer length
/// @return transmitter buffer length
int usbTxBufferLen();

/// @brief Write data to the USB port
/// @param data data pointer
/// @param size number of bytes to write
/// @return number of bytes written
int usbWrite(const uint8_t *data, uint32_t size);

/// @brief basic print function
/// Does not support floating point, does not print a new line
/// @param format C standard string format
/// @param variables to parse into the string 
/// @return Number of bytes written
int printu(const char *format, ...);

/// @brief basic println function
/// Does not support floating point, does print a new line
/// @param format C standard string format
/// @param variables to parse into the string 
/// @return Number of bytes written
int printuln(const char *format, ...);

}
```
